## arch/arm_m/config/kconfig.stm32f4
```kconfig
menu "Linker Script Config"

    menu "Flash Config"
    config LD_FLASH_START_ADDRESS
        hex "FLASH Start Address"
        default 0x08000000
        help
            Set the start address of the flash memory.
    config LD_KERNEL_USE_FLASH_SIZE
        int "Flash Size (KiB)"
        default 1024
        help
            Set the size of the flash space  (in KiB).
    endmenu
        
    menu "RAM Config" 
    config LD_RAM_START_ADDRESS
        hex "RAM Start Address"
        default 0x20000000
        help
            Set the start address of the RAM memory.
    config LD_KERNEL_USE_RAM_SIZE
        int "RAM Size (KiB)"
        default 128
        help
            Set the size of the RAM space  (in KiB).
    endmenu   
endmenu


source "arch/arm_m/kernel/kconfig"
source "kconfig"
```

## arch/arm_m/kconfig
```kconfig
menu "ARCH Config" 


endmenu   




source "arch/arm_m/kernel/kconfig"
source "kconfig"
```

## arch/arm_m/kernel/kconfig
```kconfig
menu "Boot Configuration"
    menu "interrupt Config"
    config INTERRUPT_NUMBERS
        int "interrupt numbers"
        default 64
        help
            This config is use for create new interrupt vector scale.
    endmenu
endmenu
```

## arch/arm_m/mach-raspberrypi/rp2350/kconfig
```kconfig
menu "Linker Script Config"

    menu "Flash Config"
    config LD_FLASH_START_ADDRESS
        hex "FLASH Start Address"
        default 0x10100000
        help
            Set the start address of the flash memory.
    config LD_KERNEL_USE_FLASH_SIZE
        int "Flash Size (KiB)"
        default 2048
        help
            Set the size of the flash space  (in KiB).
    endmenu
    
    menu "RAM Config" 
    config LD_RAM_START_ADDRESS
        hex "RAM Start Address"
        default 0x20008000
        help
            Set the start address of the RAM memory.
    config LD_KERNEL_USE_RAM_SIZE
        int "RAM Size (KiB)"
        default 480
        help
            Set the size of the RAM space  (in KiB).
    endmenu   
endmenu

source "arch/arm_m/kconfig"
```

## arch/arm_m/mach-st/stm32h743/kconfig
```kconfig
menu "Linker Script Config"

    menu "Flash Config"
    config LD_FLASH_START_ADDRESS
        hex "FLASH Start Address"
        default 0x8000000
        help
            Set the start address of the flash memory.
    config LD_KERNEL_USE_FLASH_SIZE
        int "Flash Size (KiB)"
        default 2048
        help
            Set the size of the flash space  (in KiB).
    endmenu
        
    menu "RAM Config" 
    config LD_RAM_START_ADDRESS
        hex "RAM Start Address"
        default 0x24000000
        help
            Set the start address of the RAM memory.
    config LD_KERNEL_USE_RAM_SIZE
        int "RAM Size (KiB)"
        default 512
        help
            Set the size of the RAM space  (in KiB).
    endmenu   
endmenu

source "arch/arm_m/kconfig"
```

## drivers/kconfig
```kconfig
menu "Device Drivers"

  menu "tty"
  config UART1_SPEED
      int "UART1 baud rate"
      default 115200
      help
        Set the baud rate for UART1.
  endmenu
  

  menu "SPI Flash"
  config W25QXX_SPI_FLASH
      bool "Enable W25QXX SPI Flash"
      default y
      help
        Enable or disable the W25QXX SPI Flash support.
  
  config W25QXX_SPI_FLASH_CS_PIN
      int "W25QXX CS Pin (GPIO number)"
      default 4
      help
        Set the GPIO pin number for the Chip Select (CS) of the SPI Flash.
  
  config W25QXX_SPI_FLASH_SPI_DEVICE
      string "W25QXX SPI device path"
      default "/dev/spidev1"
      help
        Set the device path for the W25QXX SPI Flash.
  endmenu
  
endmenu
  

  
```

## fs/kconfig
```kconfig
menu "File System Configuration"

  config ROOT_FILE_SYSTEM_MOUNT
    string "Root Filesystem Type"
    default "initramfs"
    help
     mount init ramsystem type;


  source "./fs/devfs/kconfig"
  source "./fs/pipefs/kconfig"
  source "./fs/initramfs/kconfig"




endmenu
```

## fs/pipefs/kconfig
```kconfig
menu "pipe config"
    
    config PIPE_FILE_SYSTEM_NODE_BUFFER_SIZE
        int "pipe buffer size config(byte) "
        default 1024
        help
          Set pipe buffer size.

endmenu
```

## kconfig
```kconfig
source "./fs/kconfig"
source "./kernel/kconfig"
source "./lib/kconfig"
source "./drivers/kconfig"
```

## kernel/kconfig
```kconfig
source "./kernel/mm/kconfig"

menu "Kernel Core Features"
        
  menu "SYMBOL_TABLE"
  config USE_EXPORT_SYMBOL_TABLE
      bool "Use export symbol tabe to mannage kernel lib"
      default n
      help
        This function will use plenty much flash space ,
        if you want load elf file to add function when kernel is running 
  endmenu
  

source "./kernel/sched/kconfig"

config ARCH_USE_CMPXCHG_LOCKREF
  bool "Use cmpxchg64-based lockref implementation"
  default n
  help
    Enable this option if your platform supports 64-bit cmpxchg 
    and SMP operation, for lockref performance optimization.

config CPU_BIG_ENDIAN
    bool "Build big-endian kernel"
    default n
    help
      Say Y if you plan to run this kernel on a big-endian ARM system.

endmenu
```

## kernel/mm/kconfig
```kconfig
menu "Kernel Memory Pool"


config KERNEL_MAIN_HEAP_SIZE
    int "Main heap size (KB)"
    default 120
    help
      Set the size of the main kernel heap in kilobytes.



config EXPAND_HEAP_1_RUN_TASK
    bool "Enable expand heap1 for task run stack"
    default n
    help
      Enable or disable the use of expand heap1 for task run stack.

config EXPAND_HEAP_1_START_ADDR
    hex "Expand heap1 start address"
    default 0x10000000
    help
      Define the start address for expand heap1.

config EXPAND_HEAP_1_SIZE
    int "Expand heap1 size (KB)"
    default 0
    help
      Set the size of expand heap1 in kilobytes.



config EXPAND_HEAP_2_TASK_RUN
    bool "Enable expand heap2 for task run stack"
    default n
    help
      Enable or disable the use of expand heap2 for task run stack.

config EXPAND_HEAP_2_START_ADDR
    hex "Expand heap2 start address"
    default 0x70000000
    help
      Define the start address for expand heap2.

config EXPAND_HEAP_2_SIZE
    int "Expand heap2 size (KB)"
    default 0
    help
      Set the size of expand heap2 in kilobytes.




config EXPAND_HEAP_3_TASK_RUN
    bool "Enable expand heap3 for task run stack"
    default n
    help
      Enable or disable the use of expand heap3 for task run stack.

config EXPAND_HEAP_3_START_ADDR
    hex "Expand heap3 start address"
    default 0x00000000
    help
      Define the start address for expand heap3.

config EXPAND_HEAP_3_SIZE
    int "Expand heap3 size (KB)"
    default 0
    help
      Set the size of expand heap3 in kilobytes.




config EXPAND_HEAP_4_TASK_RUN
    bool "Enable expand heap4 for task run stack"
    default n
    help
      Enable or disable the use of expand heap4 for task run stack.

config EXPAND_HEAP_4_START_ADDR
    hex "Expand heap4 start address"
    default 0x00000000
    help
      Define the start address for expand heap4.

config EXPAND_HEAP_4_SIZE
    int "Expand heap4 size (KB)"
    default 0
    help
      Set the size of expand heap4 in kilobytes.




config EXPAND_HEAP_5_TASK_RUN
    bool "Enable expand heap5 for task run stack"
    default n
    help
      Enable or disable the use of expand heap5 for task run stack.

config EXPAND_HEAP_5_START_ADDR
    hex "Expand heap5 start address"
    default 0x00000000
    help
      Define the start address for expand heap5.

config EXPAND_HEAP_5_SIZE
    int "Expand heap5 size (KB)"
    default 0
    help
      Set the size of expand heap5 in kilobytes.




config EXPAND_HEAP_6_TASK_RUN
    bool "Enable expand heap6 for task run stack"
    default n
    help
      Enable or disable the use of expand heap6 for task run stack.

config EXPAND_HEAP_6_START_ADDR
    hex "Expand heap6 start address"
    default 0x00000000
    help
      Define the start address for expand heap6.

config EXPAND_HEAP_6_SIZE
    int "Expand heap6 size (KB)"
    default 0
    help
      Set the size of expand heap6 in kilobytes.



      



endmenu
```

## kernel/sched/kconfig
```kconfig
menu "sched"



config SYSTEM_TICK_FREQUENCY
      int "SYSTEM TICK (HZ)"
      default 500
      help
        Set the tick frequency



config CPU_NUM
    int "Number of CPUs"
    default 1
    help
      Specify the number of CPUs in the system.

config SCHED_CPU0
    string "Scheduler module for CPU 0"
    default "Preemptive"
    help
      Specify the scheduler module name for CPU 0.
      e.g., "Preemptive", "time_loop", "EDF", etc.

config SCHED_CPU1
    string "Scheduler module for CPU 1 (if used)"
    default "time_loop"
    depends on CPU_NUM >= 2
    help
      Specify the scheduler module name for CPU 1.
      e.g., "Preemptive", "time_loop"

config SCHED_CPU2
    string "Scheduler module for CPU 2 (if used)"
    default "time_loop"
    depends on CPU_NUM >= 3
    help
      Add support as needed.

config SCHED_CPU3
    string "Scheduler module for CPU 3 (if used)"
    default "time_loop"
    depends on CPU_NUM >= 4
    help
      Add support as needed.



    
config MMU
    bool "Enable MMU"
    default n
    help
      Enable or disable Memory Management Unit (MMU).


config KTHREAD_DEFAULT_PRIORITY
      int "default task priority"
      default 8
      help
        Set Kthread create task priority(low 0 -> n heigh)

config KTHREAD_DEFAULT_STACK_SIZE
  int "kthread create task default alloc stank size(kb)"
  default 8
  help
    Set Kthread create task default stank size

config KTHREAD_DEFAULT_USE_CPU_CORE
  int "kthread default use cpu core"
  default 0
  help
    Set Kthread create task use cpu core


endmenu
```

## lib/kconfig
```kconfig
menu " Library Configuration "

  menu "printk"
    config PRINTTK_USE_TTY_DEVICE
        string "printk use device"
        default "/dev/ttyS0"
        help
          Set system log out put Device.
  endmenu


  
  menu "system timer HZ"
  config SYSTEM_TIMER_HZ
      int "SYSTEM TIMER (HZ)"
      default 1000000
      help
        Set the tick frequency
  endmenu  




  menu "Sched Support"

    config Preemptive
      bool "Enable Preemptive"
      default y
      help
        Enable or disable Preemptive sched support
  
    config time_loop
      bool "Enable time_loop"
      default n
      help
        Enable or disable time_loop sched support
  endmenu    


  menu "CRC Configuration"

    config CRC4
      bool "Enable crc4"
      default n
      help
        Enable or disable crc4 support

    config CRC7
      bool "Enable crc7"
      default n
      help
        Enable or disable crc7 support

    config CRC8
      bool "Enable crc8"
      default n
      help
        Enable or disable crc8 support

    config CRC16
      bool "Enable crc16"
      default n
      help
        Enable or disable crc16 support
  
    config CRC32
      bool "Enable crc32"
      default n
      help
        Enable or disable crc32 support

  endmenu    



  

endmenu
```
